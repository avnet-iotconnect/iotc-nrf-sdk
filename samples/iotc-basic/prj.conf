## CMakeLists.txt
```
#
# Copyright (c) 2020 Nordic Semiconductor
#
# SPDX-License-Identifier: LicenseRef-BSD-5-Clause-Nordic
#
option(CLION "CLion IDE Integration" OFF)

cmake_minimum_required(VERSION 3.8.2)

if (CLION)
    # instructions for CLION:
    # use File-Settings->Build,Execution,Deployment->Cmake
    # cmake options: -DCLION=on
    # environment CLION=yes;GNUARMEMB_TOOLCHAIN_PATH=<path_to>/gnuarmemb;ZEPHYR_BASE=<path_to>/ncs/zephyr
    # build options: -- -j 4 (if you want faster builds)


    message("Using CLION with " $ENV{GNUARMEMB_TOOLCHAIN_PATH} " " $ENV{ZEPHYR_BASE})

    set(ENV{BOARD} thingy91_nrf9160ns)
    set(ENV{BOARD_DIR} $ENV{ZEPHYR_BASE}/boards/arm/thingy91_nrf9160)

    set(ENV{ZEPHYR_TOOLCHAIN_VARIANT} gnuarmemb)

    set(ENV{CMAKE_AR} $ENV{GNUARMEMB_TOOLCHAIN_PATH}/bin/arm-none-eabi-ar)
    set(ENV{CMAKE_AS} $ENV{GNUARMEMB_TOOLCHAIN_PATH}/bin/arm-none-eabi-as)
    set(ENV{CMAKE_ASM_COMPILER} $ENV{GNUARMEMB_TOOLCHAIN_PATH}/bin/arm-none-eabi-gcc)
    set(ENV{CMAKE_ASM_COMPILER_AR} $ENV{GNUARMEMB_TOOLCHAIN_PATH}/bin/arm-none-eabi-gcc-ar)
    set(ENV{CMAKE_ASM_COMPILER_RANLIB} $ENV{GNUARMEMB_TOOLCHAIN_PATH}/bin/arm-none-eabi-gcc-ranlib)

    set(ENV{CMAKE_ASM_FLAGS_DEBUG} -g)
    set(ENV{CMAKE_ASM_FLAGS_MINSIZEREL} -Os -DNDEBUG)
    set(ENV{CMAKE_ASM_FLAGS_RELEASE} -O3 -DNDEBUG)
    set(ENV{CMAKE_ASM_FLAGS_RELWITHDEBINFO} -O2 -g -DNDEBUG)

    set(ENV{CMAKE_CXX_COMPILER} $ENV{GNUARMEMB_TOOLCHAIN_PATH}/bin/arm-none-eabi-g++)
    set(ENV{CMAKE_CXX_COMPILER_AR} $ENV{GNUARMEMB_TOOLCHAIN_PATH}/bin/arm-none-eabi-gcc-ar)
    set(ENV{CMAKE_CXX_COMPILER_RANLIB} $ENV{GNUARMEMB_TOOLCHAIN_PATH}/bin/arm-none-eabi-gcc-ranlib)
endif ()

set(PM_STATIC_YML_FILE
        ${CMAKE_CURRENT_SOURCE_DIR}/../../common/project-files/configuration/${BOARD}/pm_static.yml
        )
list(APPEND mcuboot_OVERLAY_CONFIG
        "${CMAKE_CURRENT_SOURCE_DIR}/../../common/project-files//mcuboot_overlay-rsa.conf"
        )

# we use some pragmas to suppress CLion warnings
add_definitions("-Wno-unknown-pragmas")

set(WITH_FEATURE_ZEPHYR)

# TODO: figure out how to deal with path warnings
cmake_policy(SET CMP0076 NEW)

find_package(Zephyr REQUIRED HINTS $ENV{ZEPHYR_BASE})

project(iotc-basic)
zephyr_compile_definitions(PROJECT_NAME=${PROJECT_NAME})
zephyr_compile_definitions(_POSIX_C_SOURCE=200809L)

target_sources(app PRIVATE src/main.c)
target_sources(app PRIVATE src/test_certs.c)

# several ways to add the cJSON latest library version 1.7.13
# - update the source files in ncs/nrf/ext/cjson/ and include JSON library in prj.config
# - include the actual library as-is and link it in
# - just add cJSON dir and cJSON.c file. This is the simples approach that we are using, though not the cleanest.
#   NOTE: cJSON is currently in .gitignore. Modify it if you want to add it to your source control

zephyr_include_directories(../../cJSON)
zephyr_library_sources(../../cJSON/cJSON.c)

add_subdirectory_ifdef(CONFIG_BOARD_THINGY91_NRF9160NS ../../common/ui build/common/ui)

add_subdirectory(../../iotconnect-sdk build/iotconnect-sdk)
```

## Kconfig
```
#
# Copyright (c) 2020 Avnet
#
# Sample app config
#

menu "IoTConnect Sample"

config PROVISION_TEST_CERTIFICATES
	bool "Provision test certificates with source"
	help
		Enabling this option will trigger the mechanism to program the test certs and keys
		a set of devices
	default false

config IOTCONNECT_CUSTOM_DUID
	string "Optional custom Device Unique ID (default nrf-IMEI)"
	help
		If provided, a custom custom Device Unique ID will be used. Otherwise a generated ID will be used nrf-IMEI.
		Maximum 64 characters.
	default ""

config IOTCONNECT_CPID
	string "IoTConnect Company ID"
	help
		Settings -> Company Profile. Usually a long hex string like ABCDEF123456789A...
	default ""

config IOTCONNECT_ENV
    string "IoTConnect Environment"
	help
		Environment name. Contact your representative for details.
	default ""

config TELEMETRY_SEND_INTERVAL_SECS
	int "How many seconds to back off before sending telemetry"
	help
		A shorter interval means that data is sent more often and that it uses more bandwidth.
	default 5

config TELEMETRY_DURATION_MINUTES
	int "How many minutes to keep sending telemetry"
	help
		This value is used to limit the amount of data we send to the cloud and avoid sim card charges during testing.
		After the period exires, the board will disconnect from the cloud.
		You can set this value to a negative number if you wish to send data indefinitely.
	default 5

config MAIN_LOOP_INTERVAL_MS
	int "How many milliseconds to wait before returning to main loop"
	help
	    The main loop will execute iotconnect loop and allow mqtt to send/receive data.
	    Shorter loop interval means that we receive events from the cloud quciker.
	    Longer loop interval may cause mqtt connection to time out. It should not be more than several seconds.
	default 100


menuconfig THINGY_SENSORS
	select SENSOR
	bool "Enable Thingy91 Sensors"
	default y if BOARD_THINGY91_NRF9160NS
	select PWM if BOARD_THINGY91_NRF9160NS
	select PWM_0 if BOARD_THINGY91_NRF9160NS


endmenu

rsource "../../iotconnect-sdk/Kconfig"

menu "Zephyr Kernel"
source "$ZEPHYR_BASE/Kconfig.zephyr"

endmenu
```

## sample.yaml
```
sample:
  name: IoTConnect Sensors Sample
tests:
  test_build:
    build_only: true
    build_on_all: true
    platform_whitelist: nrf9160dk_nrf9160ns thingy91_nrf9160ns
    tags: ci_build
```

## prj.conf
```kconfig
# Download client for OTA updates
CONFIG_DOWNLOAD_CLIENT=y


# sys_reboot after OTA
CONFIG_REBOOT=y

# Date/Time and Modem info (for IMEI)
CONFIG_DATE_TIME=y
CONFIG_MODEM_INFO=y
CONFIG_MODEM_INFO_ADD_NETWORK=n
CONFIG_MODEM_INFO_ADD_DATE_TIME=n
CONFIG_MODEM_INFO_ADD_SIM=n
CONFIG_MODEM_INFO_ADD_DEVICE=y

# Library for buttons and LEDs
CONFIG_DK_LIBRARY=y
CONFIG_DK_LIBRARY_INVERT_LEDS=n

# Networking
CONFIG_NETWORKING=y
CONFIG_NET_NATIVE=n
CONFIG_NET_SOCKETS_OFFLOAD=y
CONFIG_NET_SOCKETS=y
CONFIG_NET_SOCKETS_POSIX_NAMES=y

# Modem Library (formerly BSD LIB)
CONFIG_NRF_MODEM_LIB=y
CONFIG_NRF_MODEM_LIB_SYS_INIT=y
CONFIG_NRF_MODEM_LIB_TRACE_ENABLED=n

CONFIG_MODEM_KEY_MGMT=y

# LTE link control
CONFIG_LTE_LINK_CONTROL=y
CONFIG_LTE_AUTO_INIT_AND_CONNECT=n

# AT Host
CONFIG_UART_INTERRUPT_DRIVEN=y
CONFIG_AT_HOST_LIBRARY=y

# CONFIG_CJSON_LIB=n
CONFIG_NEWLIB_LIBC=y

# Added by W-ADS
CONFIG_NEWLIB_LIBC_FLOAT_PRINTF=y

# MQTT
CONFIG_MQTT_LIB=y
CONFIG_MQTT_LIB_TLS=y

# FOTA requirements BEGIN
# ======================

# Image manager
CONFIG_IMG_MANAGER=y
CONFIG_FLASH=y
CONFIG_IMG_ERASE_PROGRESSIVELY=y

# FOTA library
CONFIG_FOTA_DOWNLOAD=y

# add debugging to fota log
CONFIG_LOG=y
CONFIG_LOG_MODE_IMMEDIATE=y
CONFIG_DOWNLOAD_CLIENT_LOG_LEVEL_DBG=y

# DFU Target
CONFIG_DFU_TARGET=y

# Application Upgrade support
CONFIG_BOOTLOADER_MCUBOOT=y

# ======================
# FOTA requirements END


# Main thread. Generously allotted. Can be reduced.
CONFIG_MAIN_STACK_SIZE=4096
CONFIG_HEAP_MEM_POOL_SIZE=4096
```

## boards/nrf9160_avt9152ns.overlay
```dts
/ {
	aliases {
		sw0 = &arduino_pin17;
	};
};
```

## src/main.c
```c
#pragma clang diagnostic push
#pragma ide diagnostic ignored "cert-err34-c"
//
// Copyright: Avnet, Softweb Inc. 2020
// Modified by Nik Markovic <nikola.markovic@avnet.com> on 6/15/20.
//

#include <stdlib.h>
#include <stdio.h>

#include <zephyr.h>
#include <net/mqtt.h>

#include <modem/nrf_modem_lib.h>
#include <modem/lte_lc.h>
#include <modem/at_cmd.h>
#include <modem/at_notif.h>
#if IS_ENABLED(CONFIG_BOARD_THINGY91_NRF9160NS)
#include "led_pwm.h"
#else
#define ui_leds_init()
#define ui_led_set_rgb(a,b,c) (void) (a,b,c)
#endif
#include <power/reboot.h>
#include <dfu/mcuboot.h>
#include <dk_buttons_and_leds.h>


#include "iotconnect.h"
#include "nrf_modem_if.h"
#include "iotconnect_common.h"
#include "iotconnect_telemetry.h"
#include "iotconnect_lib.h"

#include "nrf_cert_store.h"
#include "nrf_fota.h"

#if defined(CONFIG_PROVISION_TEST_CERTIFICATES)
#include "test_certs.h"
#endif

#define PRINT_LTE_LC_EVENTS

#define SDK_VERSION STRINGIFY(APP_VERSION)
#define MAIN_APP_VERSION "01.02.00" // Use two-digit or letter version so that we can use strcmp to see if version is greater
#define LED_MAX 20U

static char duid[65] = CONFIG_IOTCONNECT_CUSTOM_DUID; // When using this code, your device ID will be nrf-IMEI.
static char *cpid = CONFIG_IOTCONNECT_CPID;
static char *env = CONFIG_IOTCONNECT_ENV;

static IotconnectNrfFotaConfig fota_config = {0};

// Various flags that drive the behavior of main loop
static bool sdk_running = false;
static bool sdk_do_run = true;    // trigger running of the SDK - by default and by button press
static bool sdk_do_shutdown = false;  // trigger stopping of the SDK loop
static bool do_reboot = false;
static bool fota_in_progress = false;
static bool lte_link_up = false;
static bool connecting_to_iotconnect = false;
static bool time_updated = false;

#if !defined(CONFIG_NRF_MODEM_LIB_SYS_INIT)

/* Initialize AT communications */
static int at_comms_init(void) {
    int err;
    err = at_cmd_init();
    if (err) {
        printk("Failed to initialize AT commands, err %d\n", err);
        return err;
    }
    err = at_notif_init();
    if (err) {
        printk("Failed to initialize AT notifications, err %d\n", err);
        return err;
    }
    return 0;
}

#endif

static bool is_app_version_same_as_ota(const char *version) {
    return strcmp(MAIN_APP_VERSION, version) == 0;
}

static bool app_needs_ota_update(const char *version) {
    return strcmp(MAIN_APP_VERSION, version) < 0;
}

static void nrf_fota_cb(const struct fota_download_evt *evt) {
    switch (evt->id) {
        case FOTA_DOWNLOAD_EVT_FINISHED:
            printk("OTA: Download finished. Board reboot is scheduled...\n");
            fota_in_progress = false;
            if (sdk_running) {
                sdk_do_shutdown = true;
            }
            do_reboot = true;
            break;
        case FOTA_DOWNLOAD_EVT_ERROR:
            // Even if we get an error, we can't do anything about it other than try again
            printk("OTA: Download error!\n");
            fota_in_progress = false;
            if (!sdk_running) {
                sdk_do_run = true;
            }
        default:
            // everything else is already handled by the fota module (prints messages)
            break;
    }
}

// Parses the URL into host and path strings.
// It re-uses the URL storage by splitting it into two null-terminated strings.
static int start_ota(char *url) {
    size_t url_len = strlen(url);
    int slash_count = 0;
    for (int i = 0; i < url_len; i++) {
        if (url[i] == '/') {
            slash_count++;
            if (slash_count == 2) {
                fota_config.host = &url[i + 1];
            } else if (slash_count == 3) {
                url[i] = 0; // terminate the host string
                fota_config.path = &url[i + 1];
                fota_config.fota_cb = nrf_fota_cb;
                fota_config.apn = NULL;
                return nrf_fota_start(&fota_config);
            }
        }
    }
    return -EINVAL;
}

static void on_ota(IotclEventData data) {
    const char *message = NULL;
    char *url = iotcl_clone_download_url(data, 0);
    bool success = false;
    if (NULL != url) {
        printk("Download URL is: %s\n", url);
        const char *version = iotcl_clone_sw_version(data);
        if (is_app_version_same_as_ota(version)) {
            printk("OTA request for same version %s. Sending success\n", version);
            success = true;
            message = "Version is matching";
        } else if (app_needs_ota_update(version)) {
            int err = start_ota(url);
            if (err) {
                printk("Failed to start OTA. Error was %d\n", err);
                message = "Failed to start OTA";
            } else {
                // Don't send ack yet.
                // Wait for OTA to process, reboot and wait for a new OTA request (because we didn't respond)
                // Don't free URL and version. We will use them for OTA download
                fota_in_progress = true;
                ui_led_set_rgb(LED_MAX, LED_MAX, 0);  //yellow..
                return;
            }
        } else {
            printk("Device firmware version %s is newer than OTA version %s. Sending failure\n", MAIN_APP_VERSION,
                   version);
            // Not sure what to do here. The app version is better than OTA version.
            // Probably a development version, so return failure?
            // The user should decide here.
            success = false;
            message = "Device firmware version is newer";
        }

        free((void *) url);
        free((void *) version);
    } else {
        // compatibility with older events
        // This app does not support FOTA with older back ends, but the user can add the functionality
        const char *command = iotcl_clone_command(data);
        if (NULL != command) {
            // URL will be inside the command
            printk("Command is: %s\n", command);
            message = "Back end version 1.0 not supported by the app";
            free((void *) command);
        }
    }
    const char *ack = iotcl_create_ack_string_and_destroy_event(data, success, message);
    if (NULL != ack) {
        printk("Sent OTA ack: %s\n", ack);
        iotconnect_sdk_send_packet(ack);
        free((void *) ack);
    }
}

static void on_twin_command(IotclEventData payload)
{

    TwinStrings *result = iotcl_get_twin_key_and_value(payload);
    
    /*
     Type    : Public Method "iotconnect_update_twin()"
     Usage   : Upate the twin reported property
     Output  : 
     Input   : "key" and "value" as below
               // String key = "<< Desired property key >>"; // Desired proeprty key received from Twin callback message
               // String value = "<< Desired Property value >>"; // Value of respective desired property
    */    
     iotconnect_update_twin(result->key,result->value);

    // Don't forget to free the allocated memory
    free(result);
    
}



static void on_command(IotclEventData data) {
    const char *command = iotcl_clone_command(data);
    if (NULL != command) {
        printk("Received command: %s\n", command);
        free((void *) command);
    }
    const char *ack = iotcl_create_ack_string_and_destroy_event(data, false, "Not implemented");
    if (NULL != ack) {
        printk("Sent CMD ack: %s\n", ack);
        iotconnect_sdk_send_packet(ack);
        free((void *) ack);
    } else {
        printk("Error while creating the ack JSON");
    }
}

static void on_connection_status(IotconnectConnectionStatus status) {
    // Add your own status handling
    switch (status) {
        case MQTT_CONNECTED:
            printk("IoTConnect MQTT Connected\n");
            ui_led_set_rgb(0, LED_MAX, 0);

#if defined(CONFIG_BOOTLOADER_MCUBOOT)
            /* Mark image as good to avoid rolling back after update
             * The last image was online when downloaded, so this image better get online too
             * */
            boot_write_img_confirmed();
#endif
            break;
        case MQTT_DISCONNECTED:
            printk("IoTConnect MQTT Disconnected\n");
            ui_led_set_rgb(LED_MAX, 0, 0);
            break;
        case MQTT_FAILED:
        default:
            printk("IoTConnect MQTT ERROR\n");
            ui_led_set_rgb(0, LED_MAX, 0);
            break;
    }
}

static void publish_telemetry() {
    IotclMessageHandle msg = iotcl_telemetry_create(iotconnect_sdk_get_lib_config());

    // Optional. The first time you create a data point, the current timestamp will be automatically added
    // TelemetryAddWith* calls are only required if sending multiple data points in one packet.
    iotcl_telemetry_add_with_iso_time(msg, iotcl_iso_timestamp_now());
    iotcl_telemetry_set_string(msg, "version", MAIN_APP_VERSION);
    iotcl_telemetry_set_string(msg, "api_version", SDK_VERSION);

    // Simulated value
    iotcl_telemetry_set_number(msg, "cpu", time(NULL) % 100);

    const char *str = iotcl_create_serialized_string(msg, false);
    iotcl_telemetry_destroy(msg);
    printk("Sending: %s\n", str);
    iotconnect_sdk_send_packet(str);
    iotcl_destroy_serialized(str);
}

static int time_init() {
    int err;
    for (int tries = 0; tries < 5; tries++) {
        err = nrf_modem_get_time();
        if (err) {
            printk("Retrying to get time...\n");
            k_msleep(3000);
        } else {
            return 0;
        }
    }
    printk("Failed to initialize time!\n");
    return -ETIMEDOUT;
}

static void print_lte_lc_evt_string(const struct lte_lc_evt *const evt) {

#ifdef PRINT_LTE_LC_EVENTS

    switch (evt->type) {

        case LTE_LC_EVT_NW_REG_STATUS:

            switch ((int)evt->nw_reg_status) {

                case LTE_LC_NW_REG_REGISTERED_HOME:
                    printk("LTE network registered (Home)\n");
                    break;

                case LTE_LC_NW_REG_REGISTERED_ROAMING:
                    printk("LTE network registered (Roaming)\n");
                    break;

                case LTE_LC_NW_REG_SEARCHING:
                    printk("LTE network searching...\n");
                    break;

                case LTE_LC_NW_REG_NOT_REGISTERED:
                    printk("LTE network not registered\n");
                    break;

                case LTE_LC_NW_REG_REGISTRATION_DENIED:
                    printk("LTE network registered (HOME)\n");
                    break;

                case LTE_LC_NW_REG_UNKNOWN:
                    printk("LTE network registration status unknown\n");
                    break;

                case LTE_LC_NW_REG_REGISTERED_EMERGENCY:
                    printk("LTE network registered (Emergency)\n");
                    break;

                case LTE_LC_NW_REG_UICC_FAIL:
                    printk("SIM card UICC read fail\n");
                    break;
            }
            break;

        case LTE_LC_EVT_PSM_UPDATE:
            printk("PSM update: active time => %d, TAU => %d\n", evt->psm_cfg.active_time, evt->psm_cfg.tau);
            break;

        case LTE_LC_EVT_EDRX_UPDATE:
            printk("eDRX update: eDRX => %fs, PTW => %fs\n", evt->edrx_cfg.edrx, evt->edrx_cfg.ptw);
            break;

        case LTE_LC_EVT_RRC_UPDATE:
            printk("RRC update: mode => %s\n", (evt->rrc_mode == LTE_LC_RRC_MODE_IDLE ? "idle":"connected"));
            break;

        case LTE_LC_EVT_CELL_UPDATE:
            printk("Cell id => 0x%08X, Cell tac => 0x%08X\n", evt->cell.id, evt->cell.tac);
            break;

        case LTE_LC_EVT_LTE_MODE_UPDATE:
            printk("Received LTE_LC_EVT_LTE_MODE_UPDATE\n");
            break;

        case LTE_LC_EVT_TAU_PRE_WARNING:
            printk("Received LTE_LC_EVT_TAU_PRE_WARNING\n");
            break;

        case LTE_LC_EVT_NEIGHBOR_CELL_MEAS:
            printk("Received LTE_LC_EVT_NEIGHBOR_CELL_MEAS\n");
            break;

        case LTE_LC_EVT_MODEM_SLEEP_EXIT_PRE_WARNING:
            printk("Received LTE_LC_EVT_MODEM_SLEEP_EXIT_PRE_WARNING\n");
            break;

        case LTE_LC_EVT_MODEM_SLEEP_EXIT:
            printk("Received LTE_LC_EVT_MODEM_SLEEP_EXIT\n");
            break;

        case LTE_LC_EVT_MODEM_SLEEP_ENTER:
            printk("Received LTE_LC_EVT_MODEM_SLEEP_ENTER\n");
            break;

    }

#endif    
}

static void nrf_lte_evt_cb(const struct lte_lc_evt *const evt) {

    static enum lte_lc_nw_reg_status s_lte_nw_reg_status = LTE_LC_NW_REG_UNKNOWN;

    print_lte_lc_evt_string(evt);

    switch(evt->type){

        case LTE_LC_EVT_NW_REG_STATUS:

            s_lte_nw_reg_status = evt->nw_reg_status;

            switch((int)evt->nw_reg_status){

                case LTE_LC_NW_REG_REGISTERED_HOME:
                case LTE_LC_NW_REG_REGISTERED_ROAMING:
                    lte_link_up = true;
                    break;

                case LTE_LC_NW_REG_SEARCHING:
                case LTE_LC_NW_REG_NOT_REGISTERED:
                case LTE_LC_NW_REG_REGISTRATION_DENIED:
                case LTE_LC_NW_REG_UNKNOWN:
                case LTE_LC_NW_REG_REGISTERED_EMERGENCY:
                case LTE_LC_NW_REG_UICC_FAIL:
                    lte_link_up = false;
                    break;
            }
            break;

        case LTE_LC_EVT_CELL_UPDATE:

            if (evt->cell.id == 0xFFFFFFFF) {

                if (lte_link_up) {

                    lte_link_up = false;
                    printk("LTE network down\n");
                }

            } else if (!lte_link_up) {

                if(s_lte_nw_reg_status == LTE_LC_NW_REG_REGISTERED_HOME ||
                    s_lte_nw_reg_status == LTE_LC_NW_REG_REGISTERED_ROAMING) {

                    lte_link_up = true;
                    printk("LTE network established\n");
                }
            }
            break;

        case LTE_LC_EVT_PSM_UPDATE:
        case LTE_LC_EVT_EDRX_UPDATE:
        case LTE_LC_EVT_RRC_UPDATE:
        case LTE_LC_EVT_LTE_MODE_UPDATE:
        case LTE_LC_EVT_TAU_PRE_WARNING:
        case LTE_LC_EVT_NEIGHBOR_CELL_MEAS:
        case LTE_LC_EVT_MODEM_SLEEP_EXIT_PRE_WARNING:
        case LTE_LC_EVT_MODEM_SLEEP_EXIT:
        case LTE_LC_EVT_MODEM_SLEEP_ENTER:
            break;
    }

    if (lte_link_up) {
        ui_led_set_rgb(LED_MAX, 0, LED_MAX);
    } else {
        ui_led_set_rgb(LED_MAX, LED_MAX, 0);
    }
}

static void lte_link_and_connection_handler() {

    int err;

    while (!lte_link_up || !time_updated ||
            (!iotconnect_sdk_is_connected() && !connecting_to_iotconnect)) {

        if (lte_link_up) {

            if (!time_updated) {

                printk("perform time update\n");

                //perform time update
                err = time_init();
                if (err) {
                    printk("time_init() return err %d\n", err);
                    k_msleep(100);
                    continue;
                }

                time_updated = true;
            }

            //connect to IotConnect if not.
            if (!iotconnect_sdk_is_connected() && !connecting_to_iotconnect) {

                connecting_to_iotconnect = true;
                err = iotconnect_sdk_init();
                if (err) {
                    printk("Failed to connect to IoTConnect MQTT broker, err %d\n", err);
                    sdk_running = false;
                    connecting_to_iotconnect = false;
                    k_msleep(1000);
                } else {
                    ui_led_set_rgb(0, LED_MAX, LED_MAX);
                }
            }
        } else {
            if (iotconnect_sdk_is_connected()) {
                iotconnect_sdk_abort();
            }
        }
        k_msleep(1);
    }

    if (iotconnect_sdk_is_connected() && connecting_to_iotconnect) {

        connecting_to_iotconnect = false;
    }
}

static int sdk_run() {
    int err;
    sdk_running = true;
    time_t now = 0;
    time_t last_send_time = 0;
    time_t stop_send_time = 0;

    connecting_to_iotconnect = false;
    time_updated = false;

    err = lte_lc_connect_async(nrf_lte_evt_cb);
    if (err) {
        printk("Failed to connect to the LTE network, err %d\n", err);
        sdk_running = false;
        return err;
    } else {
        printk("Start establishing LTE network...\n");
    }

    do {

        lte_link_and_connection_handler();

        // measure time
        if (!now) {
            now = time(NULL);
            last_send_time = now - CONFIG_TELEMETRY_SEND_INTERVAL_SECS; // send data every 10 seconds
            stop_send_time = now + 60 * CONFIG_TELEMETRY_DURATION_MINUTES; // stop sending after a few minutes
        }

        iotconnect_sdk_loop();
        if (sdk_do_shutdown) {
            sdk_do_shutdown = false;
            break;
        }

        now = time(NULL);
        if (iotconnect_sdk_is_connected() && now - last_send_time >= CONFIG_TELEMETRY_SEND_INTERVAL_SECS) {
            last_send_time = now;
            if (!fota_in_progress) {
                publish_telemetry();

            }
        }
        if (fota_in_progress) {
            // extend telemetry duration to a full interval, just to keep things connected and avoid disconnection
            stop_send_time = now + 60 * CONFIG_TELEMETRY_DURATION_MINUTES;
        }

        k_msleep(CONFIG_MAIN_LOOP_INTERVAL_MS);

        now = time(NULL);

    } while (CONFIG_TELEMETRY_DURATION_MINUTES >= 0 && now < stop_send_time);

    // this function will stop the IoTConnect SDK
    if (iotconnect_sdk_is_connected()) {
        iotconnect_sdk_disconnect();
        k_msleep(CONFIG_MAIN_LOOP_INTERVAL_MS);
        iotconnect_sdk_loop();
        k_msleep(CONFIG_MAIN_LOOP_INTERVAL_MS);
    } else {
        iotconnect_sdk_abort();
    }
    if (!fota_in_progress) {
        // special case. don't go offline here. let fota do its thing
        lte_lc_offline();
        ui_led_set_rgb(0, 0, 0);
    } else {
        printk("-----AWAITING OTA----\n");
    }
    sdk_running = false;
    return 0;
}

static void button_handler(uint32_t button_state, uint32_t has_changed) {
    static int64_t time_button_down = 0;

    if (has_changed && (button_state & 1U) == 1U) {
        time_button_down = k_uptime_get();
    } else if (has_changed && time_button_down > 0 && (button_state & 1U) == 0) {
        if (sdk_running) {
            sdk_do_shutdown = true;
        } else {
            sdk_do_run = true;
        }
    }
}

void main(void) {
    int err;

    printk("Starting IoTConnect SDK Demo %s\n", MAIN_APP_VERSION);
    ui_leds_init();
    k_msleep(10); // let PWM initialize
    ui_led_set_rgb(LED_MAX, LED_MAX, 0);
    k_msleep(4000); // allow time for the user to connect the comm port to see the generated DUID and initialization errors

#if !defined(CONFIG_NRF_MODEM_LIB_SYS_INIT)
    err = nrf_modem_lib_init();
#else
    /* If nrf_modem_lib is initialized on post-kernel we should
     * fetch the returned error code instead of nrf_modem_lib
     */
    err = nrf_modem_lib_get_init_ret();
#endif
    if (err) {
        printk("Failed to initialize nrf_modem_lib!\n");
        return;
    }

#if !defined(CONFIG_NRF_MODEM_LIB_SYS_INIT)
    err = at_comms_init();
    if (err) {
        printk("Failed to initialize modem!\n");
        return;
    }
#endif

    err = nrf_cert_store_provision_api_certs();
    if (err) {
        printk("Failed to provision API certificates!\n");
        return;
    }

    err = nrf_cert_store_provision_ota_certs();
    if (err) {
        printk("Failed to provision OTA certificates!\n");
        return;
    }

    err = lte_lc_init();
    if (err) {
        printk("Failed to initialize the modem, err %d\n", err);
        return;
    }

    err = nrf_fota_init();
    if (err) {
        printk("Failed to initialize the OTA module, err %d\n", err);
        return;
    }

    const char *imei = nrf_modem_get_imei();

    if (!imei) {
        printk("Unable to obtain IMEI from the board!\n");
        return;
    }

#if defined(CONFIG_PROVISION_TEST_CERTIFICATES)
        /*
        if(NrfCertStore_DeleteAllDeviceCerts()) {
            printk("Failed to delete device certs\n");
        } else {
            printk("Device certs deleted\n");
        }
         */
        if (program_test_certs(env, imei)) {
            printk("Failed program certs. Error was %d. Assuming certs are already programmed.\n", err);
        } else {
            printk("Device provisioned successfully\n");
        }
#endif
    if (strlen(CONFIG_IOTCONNECT_CUSTOM_DUID) == 0) {
        strcpy(duid, "nrf-");
        strcat(duid, imei);
    }
    printk("DUID: %s\n", duid);

    dk_buttons_init(button_handler);

    if (strlen(cpid) == 0 || strlen(env) == 0) {
        printk("You must configure your CPID and ENV in Kconfig\n");
        printk("If using Segger Embedded Studio, go to Project->Configure nRF Connect SDK Project\n");
        printk("And configure Company ID and Environment values.\n");
        printk("Contact your IoTConnect representative in you need help with configuring the device.\n");
        return;
    }

    IotconnectClientConfig *config = iotconnect_sdk_init_and_get_config();
    config->cpid = cpid;
    config->duid = duid;
    config->env = env;
    config->cmd_cb = on_command;
    config->ota_cb = on_ota;
    config->status_cb = on_connection_status;
    config->twin_msg_cb = on_twin_command;

#pragma clang diagnostic push
#pragma ide diagnostic ignored "EndlessLoop"
    while (1) {
        if (sdk_do_run && !sdk_running) {
            sdk_do_run = false;

            if (!sdk_run()) {
                ui_led_set_rgb(LED_MAX, 0, 0);
                k_msleep(3000);
                ui_led_set_rgb(0, 0, 0);
            }
        }
        if (do_reboot) {
            printk("The board will reboot in 2 seconds\n");
            do_reboot = false; // pointless, but just in case...
            k_msleep(2000);
            sys_reboot(SYS_REBOOT_COLD);
        }
        k_msleep(100);
    }
#pragma clang diagnostic pop

}
```

## src/test_certs.c
```c
#include <stdbool.h>
#include <string.h>

#include "nrf_cert_store.h"
#include "test_certs.h"

/**
 * This file contains an example of how you could program your a set of your
 * certificates and keys for a few test devices.
 *
 * This is NOT the recommended way to program your devices as it will contain
 * the keys anc certs in the the actual build binaries.
 *
 * Another way to program your keys is to use the LTE Link Monitor Nordic
 * application. It has a certificate manager application. The MQTT credentials
 * are stored in Security Tag is defined by TLS_SEC_TAG_IOTCONNECT_MQTT (10701)
 * in nrf_cert_store.h. TLS_SEC_TAG_IOTCONNECT_MQTT also requires
 * the Baltimore Cyber Trust (publicly available) as "CA Certificate" in addtion
 * the the device key and cert.
 *
 */

static const char *QA_PKEY_352656100380644 =
        "-----BEGIN EC PRIVATE KEY-----\r\n"
        "MHQCAQEEIJg7p8wbSoUCTCfm6Xopgo9F0TYEQsHkoq6+yuvmGo1SoAcGBSuBBAAK\r\n"
        "oUQDQgAEfeRTZCK1tAH2mCXqN+u4qfvZEVloxw1EQpXlU7973FjLNB+N74cQNsKp\r\n"
        "qPH33U6DHfDT2ZsyPHPaChc1fjpLlQ==\r\n"
        "-----END EC PRIVATE KEY-----\r\n";


static const char *QA_CERT_352656100380644 =
        "-----BEGIN CERTIFICATE-----\r\n"
        "MIIB8DCCAZYCAQEwCgYIKoZIzj0EAwIwcTELMAkGA1UEBhMCVVMxETAPBgNVBAgM\r\n"
        "CElsbGlub2lzMRAwDgYDVQQHDAdDaGljYWdvMRAwDgYDVQQKDAdOcmZEZW1vMRQw\r\n"
        "EgYDVQQLDAtOcmZEZW1vIE9yZzEVMBMGA1UEAwwMTnJmRGVtby1UZXN0MB4XDTIw\r\n"
        "MDgxMDE4MTMwOVoXDTQ3MTIyNjE4MTMwOVowgZkxCzAJBgNVBAYTAlVTMREwDwYD\r\n"
        "VQQIDAhJbGxpbm9pczEQMA4GA1UEBwwHQ2hpY2FnbzEQMA4GA1UECgwHTnJmRGVt\r\n"
        "bzEUMBIGA1UECwwLTnJmRGVtbyBPcmcxPTA7BgNVBAMMNFFVVTFOemN4TkRBdFFV\r\n"
        "WTRSQzAwUWpRNExVRTVOMEl0LW5yZi0zNTI2NTYxMDAzODA2NDQwVjAQBgcqhkjO\r\n"
        "PQIBBgUrgQQACgNCAAR95FNkIrW0AfaYJeo367ip+9kRWWjHDURCleVTv3vcWMs0\r\n"
        "H43vhxA2wqmo8ffdToMd8NPZmzI8c9oKFzV+OkuVMAoGCCqGSM49BAMCA0gAMEUC\r\n"
        "IQCXx2NxJD6JsbfDi8rQI/ip9y63ESBr9zJkQd3LrEH6QAIgd9Zcs+a3me6nNLd8\r\n"
        "Rh9nLC8ZkFxKHFDrBhd2bQfgX0c=\r\n"
        "-----END CERTIFICATE-----\r\n";

static const char *QA_PKEY_352656100880056 =
        "-----BEGIN EC PRIVATE KEY-----\r\n"
        "MHQCAQEEIHKUqf05pmF/c1DrGa+D32/Zak+slJFY93XGlqBu1eceoAcGBSuBBAAK\r\n"
        "oUQDQgAEyc19YmLr4nnUYV5yvn009Ow2ZLvFdBpRm4HilHewBDYmUkhXrpeauUW7\r\n"
        "iImHs/UX4//EqcB8neQjrIABfymYAA==\r\n"
        "-----END EC PRIVATE KEY-----\r\n";

// NK#1
static const char *QA_CERT_352656100880056 =
        "-----BEGIN CERTIFICATE-----\r\n"
        "MIIB8TCCAZYCAQEwCgYIKoZIzj0EAwIwcTELMAkGA1UEBhMCVVMxETAPBgNVBAgM\r\n"
        "CElsbGlub2lzMRAwDgYDVQQHDAdDaGljYWdvMRAwDgYDVQQKDAdOcmZEZW1vMRQw\r\n"
        "EgYDVQQLDAtOcmZEZW1vIE9yZzEVMBMGA1UEAwwMTnJmRGVtby1UZXN0MB4XDTIw\r\n"
        "MDgxMDE4MTMwOVoXDTQ3MTIyNjE4MTMwOVowgZkxCzAJBgNVBAYTAlVTMREwDwYD\r\n"
        "VQQIDAhJbGxpbm9pczEQMA4GA1UEBwwHQ2hpY2FnbzEQMA4GA1UECgwHTnJmRGVt\r\n"
        "bzEUMBIGA1UECwwLTnJmRGVtbyBPcmcxPTA7BgNVBAMMNFFVVTFOemN4TkRBdFFV\r\n"
        "WTRSQzAwUWpRNExVRTVOMEl0LW5yZi0zNTI2NTYxMDA4ODAwNTYwVjAQBgcqhkjO\r\n"
        "PQIBBgUrgQQACgNCAATJzX1iYuviedRhXnK+fTT07DZku8V0GlGbgeKUd7AENiZS\r\n"
        "SFeul5q5RbuIiYez9Rfj/8SpwHyd5COsgAF/KZgAMAoGCCqGSM49BAMCA0kAMEYC\r\n"
        "IQD0O/jTQHnfpVnPChp2+YagjiLqC0LbbEy7CHMVK8lI3wIhAJJUkcZxqHmBMEDL\r\n"
        "dDqXbVK098xolz+G5wan6S4p27OB\r\n"
        "-----END CERTIFICATE-----\r\n";

// TK#1
static const char *QA_PKEY_352656100878605 =
        "-----BEGIN EC PRIVATE KEY-----\r\n"
        "MHQCAQEEIOHIMJ04dxmvupQKoe3v+FqvPkenpHL4NaDmL6kaTkd3oAcGBSuBBAAK\r\n"
        "oUQDQgAEJ79o+SSkng7G9XDUqy4Tt3sCUxhAjKKff1GSxyp78oo/V1mfCZkWLVhU\r\n"
        "1VvagTCGyhyKh0adqunQuvgv3XoPIQ==\r\n"
        "-----END EC PRIVATE KEY-----\r\n";

static const char *QA_CERT_352656100878605 =
        "-----BEGIN CERTIFICATE-----\r\n"
        "MIIB8TCCAZYCAQEwCgYIKoZIzj0EAwIwcTELMAkGA1UEBhMCVVMxETAPBgNVBAgM\r\n"
        "CElsbGlub2lzMRAwDgYDVQQHDAdDaGljYWdvMRAwDgYDVQQKDAdOcmZEZW1vMRQw\r\n"
        "EgYDVQQLDAtOcmZEZW1vIE9yZzEVMBMGA1UEAwwMTnJmRGVtby1UZXN0MB4XDTIw\r\n"
        "MDgxMDE4MTMwOVoXDTQ3MTIyNjE4MTMwOVowgZkxCzAJBgNVBAYTAlVTMREwDwYD\r\n"
        "VQQIDAhJbGxpbm9pczEQMA4GA1UEBwwHQ2hpY2FnbzEQMA4GA1UECgwHTnJmRGVt\r\n"
        "bzEUMBIGA1UECwwLTnJmRGVtbyBPcmcxPTA7BgNVBAMMNFFVVTFOemN4TkRBdFFV\r\n"
        "WTRSQzAwUWpRNExVRTVOMEl0LW5yZi0zNTI2NTYxMDA4Nzg2MDUwVjAQBgcqhkjO\r\n"
        "PQIBBgUrgQQACgNCAAQnv2j5JKSeDsb1cNSrLhO3ewJTGECMop9/UZLHKnvyij9X\r\n"
        "WZ8JmRYtWFTVW9qBMIbKHIqHRp2q6dC6+C/deg8hMAoGCCqGSM49BAMCA0kAMEYC\r\n"
        "IQC/spakcGnJS8p+7IuxEeXp4vs5fOb/gbkZWTLF+FOPcAIhAPRORA2iKz9OpOmh\r\n"
        "OXIf+XELpauDSRvGHpDuYkPvxF8S\r\n"
        "-----END CERTIFICATE-----\r\n";

// TK#2
static const char *QA_PKEY_352656100877458 =
        "-----BEGIN EC PRIVATE KEY-----\r\n"
        "MHQCAQEEINpaSibzzB4kuPFuOufGiaRzjeVFus+aYeLkDLdBXJlSoAcGBSuBBAAK\r\n"
        "oUQDQgAETwzU14fFJEzYFA3WumsuKf6jok46db4B4iOcl3zS/GrwHzmcmg0vXiKF\r\n"
        "R7Gd8WiUCpersMs+9TrmG+upF4CJnw==\r\n"
        "-----END EC PRIVATE KEY-----\r\n";

static const char *QA_CERT_352656100877458 =
        "-----BEGIN CERTIFICATE-----\r\n"
        "MIIB8DCCAZYCAQEwCgYIKoZIzj0EAwIwcTELMAkGA1UEBhMCVVMxETAPBgNVBAgM\r\n"
        "CElsbGlub2lzMRAwDgYDVQQHDAdDaGljYWdvMRAwDgYDVQQKDAdOcmZEZW1vMRQw\r\n"
        "EgYDVQQLDAtOcmZEZW1vIE9yZzEVMBMGA1UEAwwMTnJmRGVtby1UZXN0MB4XDTIw\r\n"
        "MDgxMDE4MTMwOVoXDTQ3MTIyNjE4MTMwOVowgZkxCzAJBgNVBAYTAlVTMREwDwYD\r\n"
        "VQQIDAhJbGxpbm9pczEQMA4GA1UEBwwHQ2hpY2FnbzEQMA4GA1UECgwHTnJmRGVt\r\n"
        "bzEUMBIGA1UECwwLTnJmRGVtbyBPcmcxPTA7BgNVBAMMNFFVVTFOemN4TkRBdFFV\r\n"
        "WTRSQzAwUWpRNExVRTVOMEl0LW5yZi0zNTI2NTYxMDA4Nzc0NTgwVjAQBgcqhkjO\r\n"
        "PQIBBgUrgQQACgNCAARPDNTXh8UkTNgUDda6ay4p/qOiTjp1vgHiI5yXfNL8avAf\r\n"
        "OZyaDS9eIoVHsZ3xaJQKl6uwyz71OuYb66kXgImfMAoGCCqGSM49BAMCA0gAMEUC\r\n"
        "IFcejowHG6KkE5fNBSg7qhM7EFEiNiLoVFahOWNK87JcAiEAt7lsKt0irTpVVILS\r\n"
        "dPtxn389ifSveVaiyFNl+bc1S8U=\r\n"
        "-----END CERTIFICATE-----\r\n";

// TS#1
// nrf-352656100883605
static const char *QA_PKEY_352656100883605 =
        "-----BEGIN EC PRIVATE KEY-----\r\n"
        "MHQCAQEEIOnReXv11Aup2KAAoXBcG+j5hse2NTQKOBWnpC07nsRtoAcGBSuBBAAK\r\n"
        "oUQDQgAEpLe0tSCyUdbLB8L88ou9nmrKSqkhJL4f7+KcrxF1+RsONT9siH0273nl\r\n"
        "RnMuwOA3BBMHDBmenHh+aqO6D4eziw==\r\n"
        "-----END EC PRIVATE KEY-----\r\n";

static const char *QA_CERT_352656100883605 =
        "-----BEGIN CERTIFICATE-----\r\n"
        "MIIB8DCCAZYCAQEwCgYIKoZIzj0EAwIwcTELMAkGA1UEBhMCVVMxETAPBgNVBAgM\r\n"
        "CElsbGlub2lzMRAwDgYDVQQHDAdDaGljYWdvMRAwDgYDVQQKDAdOcmZEZW1vMRQw\r\n"
        "EgYDVQQLDAtOcmZEZW1vIE9yZzEVMBMGA1UEAwwMTnJmRGVtby1UZXN0MB4XDTIw\r\n"
        "MDgxMDE4MTMwOVoXDTQ3MTIyNjE4MTMwOVowgZkxCzAJBgNVBAYTAlVTMREwDwYD\r\n"
        "VQQIDAhJbGxpbm9pczEQMA4GA1UEBwwHQ2hpY2FnbzEQMA4GA1UECgwHTnJmRGVt\r\n"
        "bzEUMBIGA1UECwwLTnJmRGVtbyBPcmcxPTA7BgNVBAMMNFFVVTFOemN4TkRBdFFV\r\n"
        "WTRSQzAwUWpRNExVRTVOMEl0LW5yZi0zNTI2NTYxMDA4ODM2MDUwVjAQBgcqhkjO\r\n"
        "PQIBBgUrgQQACgNCAASkt7S1ILJR1ssHwvzyi72easpKqSEkvh/v4pyvEXX5Gw41\r\n"
        "P2yIfTbveeVGcy7A4DcEEwcMGZ6ceH5qo7oPh7OLMAoGCCqGSM49BAMCA0gAMEUC\r\n"
        "IEb6Brw3wYBiQ6GbL+AwGQNh3F0fOMUoEOJqoiNDbSsVAiEA4OAS/P2NmiczSBTY\r\n"
        "B+Fq/VAMVrNnam5EGXlAsvc2Gkw=\r\n"
        "-----END CERTIFICATE-----\r\n";


int program_test_certs(const char *env, const char *imei) {
    int err = 0;

    // in this example, we will hardocde some QA certificates in our provisioning build
    // but only if environment = "qa".
    if (0 == strcmp("qa", env)) {
        if (0 == strcmp("352656100380644", imei)) {
            err = nrf_cert_store_save_device_cert(
                    QA_PKEY_352656100380644,
                    QA_CERT_352656100380644
            );
        } else if (0 == strcmp("352656100880056", imei)) {
            err = nrf_cert_store_save_device_cert(
                    QA_PKEY_352656100880056,
                    QA_CERT_352656100880056
            );
        } else if (0 == strcmp("352656100878605", imei)) {
            err = nrf_cert_store_save_device_cert(
                    QA_PKEY_352656100878605,
                    QA_CERT_352656100878605
            );
        } else if (0 == strcmp("352656100877458", imei)) {
            err = nrf_cert_store_save_device_cert(
                    QA_PKEY_352656100877458,
                    QA_CERT_352656100877458
            );
        } else if (0 == strcmp("352656100883605", imei)) {
            err = nrf_cert_store_save_device_cert(
                    QA_PKEY_352656100883605,
                    QA_CERT_352656100883605
            );
        }
    }

    return err;
}
```

## src/test_certs.h
```c
//
// Copyright: Avnet 2020
// Modified by Nik Markovic <nikola.markovic@avnet.com> on 6/15/20.
//


#ifndef IOTCONNECT_SAMPLE_TEST_CERTS_H
#define IOTCONNECT_SAMPLE_TEST_CERTS_H

int program_test_certs(const char* env, const char* imei);

#endif //IOTCONNECT_SAMPLE_TEST_CERTS_H
```
